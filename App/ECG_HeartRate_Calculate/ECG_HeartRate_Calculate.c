/*********************************************************************************************************
* 模块名称: XXX.c
* 摘    要: 模块实现具体功能
* 当前版本: 1.0.0
* 作    者: XXX
* 完成日期: 2024年12月14日
* 内    容:
* 注    意:
**********************************************************************************************************
* 取代版本:
* 作    者:
* 完成日期:
* 修改内容:
* 修改文件:
*********************************************************************************************************/

/*********************************************************************************************************
*                                              包含头文件
*********************************************************************************************************/
#include "ECG_HeartRate_Calculate.h"
#include "ECG.h"
#include "UART1.h"

/*********************************************************************************************************
*                                              宏定义
*********************************************************************************************************/
#define ECG_Reference_Multiple 0.97
#define ECG_Statistic_Num 240
/*********************************************************************************************************
*                                              枚举结构体定义
*********************************************************************************************************/

/*********************************************************************************************************
*                                              内部变量
*********************************************************************************************************/
static double ECG_Peak_Index[ECG_Statistic_Num]={0};
static double ECG_Peak_TM_DIffer[ECG_Statistic_Num]={0};
static double ECG_HeartRate = 0;

/*********************************************************************************************************
*                                              内部函数声明
*********************************************************************************************************/
double ECG_HR_FindReference(void);
int ECG_HR_FindPeak(double ECG_Reference);
int ECG_HR_AverageTime(int ECG_PeakNum);
void ECG_HR_Cal(int ECG_Peak_TM_DIffer_Count);
float GetMidValue1(float* data,unsigned short len);

/*********************************************************************************************************
*                                              内部函数实现
*********************************************************************************************************/
/*********************************************************************************************************
* 函数名称: ECG_HR_FindReference
* 函数功能: 心率最大值查找参考值
* 输入参数: void
* 输出参数: void
* 返 回 值: void
* 创建日期: 2025年11月26日
* 注    意:
*********************************************************************************************************/
double ECG_HR_FindReference()
{ 
  double Maximum = ECG_WaveData[0];
  double ECG_Reference=0;
  int i = 0;
  for(i = 0;i < ECG_ADC_arrMAX ; i++)
  {
    if(ECG_WaveData[i] > Maximum)
    {
      Maximum = ECG_WaveData[i];
    }
  }
  ECG_Reference = Maximum * ECG_Reference_Multiple;
  return ECG_Reference;
}
/*********************************************************************************************************
* 函数名称: ECG_HR_FindMAX
* 函数功能: 心电心率查找最大值
* 输入参数: void
* 输出参数: void
* 返 回 值: void
* 创建日期: 2025年11月26日
* 注    意:
*********************************************************************************************************/
int ECG_HR_FindPeak(double ECG_Reference)
{
  int ECG_PeakNum = 0;
  int i = 0;
  for(i = 0;i < ECG_ADC_arrMAX - 1 ; i++)
  {
    if(ECG_WaveData[i] >= ECG_Reference &&  // 超过阈值
     ECG_WaveData[i] > ECG_WaveData[i-1] &&  // 比前一点大
     ECG_WaveData[i] > ECG_WaveData[i+1])
    {
      if(ECG_PeakNum >= ECG_Statistic_Num)
      {
        break;
      }
      ECG_Peak_Index[ECG_PeakNum++] = i;
    }
  }
  return ECG_PeakNum;
}

/*********************************************************************************************************
* 函数名称: ECG_HR_AverageTime
* 函数功能: 心电心率计算平均时间每次
* 输入参数: void
* 输出参数: void
* 返 回 值: void
* 创建日期: 2025年11月26日
* 注    意:
*********************************************************************************************************/
int ECG_HR_AverageTime(int ECG_PeakNum)
{
  int ECG_Peak_TM_DIffer_Count = ECG_PeakNum;
  int i = 0;
  for(i = 0;i < ECG_PeakNum - 1 ; i++)        //由于i+1，ECG_PeakNum必须-1
  {
    ECG_Peak_TM_DIffer[i] = ECG_Peak_Index[i+1] - ECG_Peak_Index[i];
  }
  return ECG_Peak_TM_DIffer_Count;
}

/*********************************************************************************************************
* 函数名称: ECG_HR_Cal
* 函数功能: 心电心率计算
* 输入参数: void
* 输出参数: void
* 返 回 值: void
* 创建日期: 2025年11月26日
* 注    意:
*********************************************************************************************************/
void ECG_HR_Cal(int ECG_Peak_TM_DIffer_Count)
{
  int ECG_TM_SUM = 0;
  int i = 0;
  if(ECG_Peak_TM_DIffer_Count <= 1)  // 至少需要2个峰值才能计算间隔
  {
    ECG_HeartRate = -1;  // 无效值标记
    return;
  }
  for(i = 0;i<ECG_Peak_TM_DIffer_Count;i++)
  {
    ECG_TM_SUM += ECG_Peak_TM_DIffer[i];
  }
  
  if(ECG_TM_SUM <= 0)
  {
    ECG_HeartRate = -1;
    return;
  }
  ECG_HeartRate = 60.0 / ((ECG_TM_SUM / ECG_Peak_TM_DIffer_Count) * (0.002 * ECG_ADC_TM));
}

/*********************************************************************************************************
*                                              API函数实现
*********************************************************************************************************/
/*********************************************************************************************************
* 函数名称: ECG_HeartRate_Calculate
* 函数功能: 心电心率计算入口
* 输入参数: void
* 输出参数: void
* 返 回 值: void
* 创建日期: 2025年11月26日
* 注    意:
*********************************************************************************************************/
void ECG_HeartRate_Calculate()
{
  double ECG_Reference = 0;
  int ECG_PeakNum = 0;
  int ECG_Peak_TM_DIffer_Count = 0;
  
  ECG_Reference = ECG_HR_FindReference();
  ECG_PeakNum = ECG_HR_FindPeak(ECG_Reference);
  ECG_Peak_TM_DIffer_Count = ECG_HR_AverageTime(ECG_PeakNum);
  ECG_HR_Cal(ECG_Peak_TM_DIffer_Count);
  ECG_HR_Send();
}

/*********************************************************************************************************
* 函数名称: ECG_HR_Send
* 函数功能: 心电心率计算
* 输入参数: void
* 输出参数: void
* 返 回 值: void
* 创建日期: 2025年11月26日
* 注    意:
*********************************************************************************************************/
void ECG_HR_Send()

{
  //printf("INFO:ECG_HeartRate:%lf",ECG_HeartRate);
  printf("[[2,%lf]]\r\n",ECG_HeartRate); //设置测量结果显示
  
}


